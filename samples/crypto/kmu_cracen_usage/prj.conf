## CMakeLists.txt
```
#
# Copyright (c) 2025 Nordic Semiconductor ASA
#
# SPDX-License-Identifier: LicenseRef-Nordic-5-Clause
#

cmake_minimum_required(VERSION 3.20.0)

find_package(Zephyr REQUIRED HINTS $ENV{ZEPHYR_BASE})

project(kmu_cracen_usage)

target_sources(app PRIVATE
  src/main.c
  src/key_operations.c
  src/ikg_keygen.c
)
```

## prj.conf
```kconfig
#
# Copyright (c) 2025 Nordic Semiconductor ASA
#
# SPDX-License-Identifier: LicenseRef-Nordic-5-Clause
#
# The Zephyr CMSIS emulation assumes that ticks are ms, currently
CONFIG_SYS_CLOCK_TICKS_PER_SEC=1000

CONFIG_MAIN_STACK_SIZE=4096
CONFIG_HEAP_MEM_POOL_SIZE=4096
CONFIG_REBOOT=y

# Enable logging
CONFIG_CONSOLE=y
CONFIG_LOG=y
CONFIG_LOG_BUFFER_SIZE=4096

# Enable nRF Security backend for PSA Crypto API
CONFIG_NRF_SECURITY=y
CONFIG_MBEDTLS_PSA_CRYPTO_C=y

# Enable hardware crypto accelerator
CONFIG_PSA_CRYPTO_DRIVER_OBERON=n
CONFIG_PSA_CRYPTO_DRIVER_CRACEN=y

CONFIG_CRACEN_IKG=y

# CONFIG_HW_UNIQUE_KEY=y
# Enable required automatic generation and storage of SEED value during the first boot
# CONFIG_HW_UNIQUE_KEY_WRITE_ON_CRYPTO_INIT=y

# Enable cryptographic features
CONFIG_PSA_WANT_KEY_TYPE_ECC_KEY_PAIR_GENERATE=y
CONFIG_PSA_WANT_KEY_TYPE_ECC_KEY_PAIR_IMPORT=y
CONFIG_PSA_WANT_KEY_TYPE_ECC_KEY_PAIR_EXPORT=y

CONFIG_PSA_WANT_ECC_TWISTED_EDWARDS_255=y
CONFIG_PSA_WANT_ECC_SECP_R1_256=y

CONFIG_PSA_WANT_ALG_SHA_256=y
CONFIG_PSA_WANT_ALG_SHA_512=y
CONFIG_PSA_WANT_ALG_ECDSA=y
CONFIG_PSA_WANT_ALG_PURE_EDDSA=y
CONFIG_PSA_WANT_ALG_CTR=y

# For key generation
CONFIG_PSA_WANT_GENERATE_RANDOM=y

# Required to enable support for Encrypted key usage scheme
CONFIG_PSA_WANT_KEY_TYPE_AES=y
CONFIG_PSA_WANT_AES_KEY_SIZE_256=y
CONFIG_PSA_WANT_ALG_ECB_NO_PADDING=y
CONFIG_PSA_WANT_ALG_CMAC=y
CONFIG_PSA_WANT_ALG_SP800_108_COUNTER_CMAC=y
CONFIG_PSA_WANT_ALG_GCM=y
```

## src/main.c
```c
/*
 * Copyright (c) 2025 Nordic Semiconductor ASA
 *
 * SPDX-License-Identifier: LicenseRef-Nordic-5-Clause
 */

#include <zephyr/kernel.h>
#include <zephyr/sys/printk.h>
#include <zephyr/logging/log.h>
#include <stdio.h>
#include <psa/crypto.h>
#include <psa/crypto_extra.h>

#include <cracen_psa_kmu.h>
#include <cracen_psa_key_ids.h>

#ifdef CONFIG_BUILD_WITH_TFM
#include <tfm_ns_interface.h>
#endif

#include "main.h"
#include "key_operations.h"
#include "ikg_keygen.h"

#define APP_SUCCESS	    (0)
#define APP_ERROR	    (-1)
#define APP_SUCCESS_MESSAGE "Example finished successfully!"
#define APP_ERROR_MESSAGE   "Example exited with error!"

LOG_MODULE_REGISTER(kmu_cracen_usage, LOG_LEVEL_DBG);

/* ====================================================================== */
/*       Global variables/defines for the KMU Cracen usage example        */

#define SAMPLE_MAX_KEY_COUNT (1)

static sample_key_entry_t m_sample_keys[SAMPLE_MAX_KEY_COUNT] = {
	/* Pre-provisioned keys.
	 * These keys remain in the KMU between MCU resets.
	 */
#if !defined(NRF_CRYPTO_EXAMPLE_DEMO_ECDSA)
	{
		/* The key requires 1 KMU slot */
		.key_id = CRACEN_BUILTIN_MKEK_ID,
		.supported_operations = {
			.gen_key_cb = NULL,
			.use_key_cb = key_operations_use_aes_key,
		}
	},
#else
	{
		.key_id = CRACEN_BUILTIN_IDENTITY_KEY_ID,
		.supported_operations = {
			.gen_key_cb = NULL,
			.use_key_cb = key_operations_use_ecdsa_key_pair,
		}
	},
#endif /* NRF_CRYPTO_EXAMPLE_DEMO_ECDSA */
	// {
	// 	/* The key requires 2 KMU slots */
	// 	.key_id = PSA_KEY_HANDLE_FROM_CRACEN_KMU_SLOT(CRACEN_KMU_KEY_USAGE_SCHEME_RAW,
	// 					       PSA_KEY_ID_USER_MIN + 1),
	// 	.supported_operations = {
	// 		.gen_key_cb = NULL,
	// 		.use_key_cb = key_operations_use_eddsa_key_pair,
	// 	}
	// },

	/* Generated keys.
	 * These keys will be erased from the KMU after MCU reset.
	 */
	// {
	// 	/* The key requires 1 KMU slot + 2 additional slots
	// 	 *are required since the key is encrypted
	// 	 */
	// 	.key_id = PSA_KEY_HANDLE_FROM_CRACEN_KMU_SLOT(CRACEN_KMU_KEY_USAGE_SCHEME_ENCRYPTED,
	// 					       PSA_KEY_ID_USER_MIN + 3),
	// 	.supported_operations = {
	// 		.gen_key_cb = key_operations_generate_aes_key,
	// 		.use_key_cb = key_operations_use_aes_key,
	// 	}
	// },
	// {
	// 	/* The key requires 2 KMU slots */
	// 	.key_id = PSA_KEY_HANDLE_FROM_CRACEN_KMU_SLOT(CRACEN_KMU_KEY_USAGE_SCHEME_RAW,
	// 					       PSA_KEY_ID_USER_MIN + 6),
	// 	.supported_operations = {
	// 		.gen_key_cb = key_operations_generate_ecdsa_key_pair,
	// 		.use_key_cb = key_operations_use_ecdsa_key_pair,
	// 	}
	// },
};

/* ====================================================================== */

int crypto_init(void)
{
	psa_status_t status;

	/* Initialize PSA Crypto */
	status = psa_crypto_init();
	if (status != PSA_SUCCESS) {
		return APP_ERROR;
	}

	return APP_SUCCESS;
}

int crypto_finish(void)
{
	psa_status_t status;

	LOG_INF("Destroying non-provisioned keys...");

	/* Destroy the key handles for generated keys only */
	for (uint8_t key_entry = 0; key_entry < SAMPLE_MAX_KEY_COUNT; key_entry++) {
		if (m_sample_keys[key_entry].supported_operations.gen_key_cb != NULL) {
			status = psa_destroy_key(m_sample_keys[key_entry].key_id);
			if (status != PSA_SUCCESS) {
				LOG_INF("psa_destroy_key failed! (Error: %d, key_entry: %d)",
					status, key_entry);
				return APP_ERROR;
			}
		}
	}

	return APP_SUCCESS;
}

int use_kmu_keys(void)
{
	psa_status_t status;
	use_key_callback_t use_key_cb;
	use_key_callback_t gen_key_cb;

	LOG_INF("Using keys...");

	for (uint8_t key_entry = 0; key_entry < SAMPLE_MAX_KEY_COUNT; key_entry++) {
		use_key_cb = m_sample_keys[key_entry].supported_operations.use_key_cb;
		gen_key_cb = m_sample_keys[key_entry].supported_operations.gen_key_cb;

		if (use_key_cb != NULL) {
			LOG_INF("Using key [%d]\n", key_entry);
			status = use_key_cb(&m_sample_keys[key_entry].key_id);
			if (status != PSA_SUCCESS) {
				LOG_INF("Failed to use key (entry: %d, error: %d)", key_entry,
					status);

				if (gen_key_cb == NULL) {
					LOG_WRN("Please make sure the key is pre-provisioned!");
				} else {
					return APP_ERROR;
				}
			}
		} else {
			LOG_WRN("Can't check key usage: no callback (entry: %d)", key_entry);
		}
	}

	LOG_INF("Key usage finished");

	return APP_SUCCESS;
}

int prepare_kmu_keys(void)
{
	psa_status_t status;
	generate_key_callback_t gen_key_cb;

	LOG_INF("Preparing non-provisioned keys...");

	for (uint8_t key_entry = 0; key_entry < SAMPLE_MAX_KEY_COUNT; key_entry++) {
		gen_key_cb = m_sample_keys[key_entry].supported_operations.gen_key_cb;

		if (gen_key_cb != NULL) {
			LOG_INF("Generating key [%d]\n", key_entry);
			status = gen_key_cb(&m_sample_keys[key_entry].key_id);
			if (status == PSA_ERROR_ALREADY_EXISTS) {
				LOG_WRN("Failed to generate key [%d]: key already exists! "
					"Erase, pre-provision and flash the board again.",
					key_entry);
			}

			if (status != PSA_SUCCESS) {
				LOG_INF("Failed to generate key (entry: %d, error: %d)", key_entry,
					status);
				return APP_ERROR;
			}
		}
	}

	LOG_INF("All keys prepared");

	return APP_SUCCESS;
}

int main(void)
{
	int status;

	LOG_INF("Starting KMU Cracen usage example...");

	status = crypto_init();
	if (status != APP_SUCCESS) {
		LOG_INF(APP_ERROR_MESSAGE);
		return APP_ERROR;
	}

	status = prepare_kmu_keys();
	if (status != APP_SUCCESS) {
		LOG_INF(APP_ERROR_MESSAGE);
		return APP_ERROR;
	}

	status = use_kmu_keys();
	if (status != APP_SUCCESS) {
		LOG_INF(APP_ERROR_MESSAGE);
		return APP_ERROR;
	}

	status = crypto_finish();
	if (status != APP_SUCCESS) {
		LOG_INF(APP_ERROR_MESSAGE);
		return APP_ERROR;
	}

	LOG_INF(APP_SUCCESS_MESSAGE);
	LOG_INF("\n\n");

	demo_ikg_keygen();

	return APP_SUCCESS;
}
```

## src/ikg_keygen.c
```c
/*
 * Copyright (c) 2026 Nordic Semiconductor ASA
 *
 * SPDX-License-Identifier: LicenseRef-Nordic-5-Clause
 */

#include "ikg_keygen.h"
#include "main.h"

#include <zephyr/device.h>
#include <zephyr/logging/log.h>
#include <zephyr/settings/settings.h>

#include <cracen/common.h>
#include <sxsymcrypt/blkcipher.h>

LOG_MODULE_DECLARE(kmu_cracen_usage, LOG_LEVEL_DBG);

/* ====================================================================== */
/*	Global variables/defines for operations 			  */

#define PRINT_HEX(p_label, p_text, len)                                                            \
	({                                                                                         \
		LOG_INF("---- %s (len: %u): ----", p_label, len);                                  \
		LOG_HEXDUMP_INF(p_text, len, "Content:");                                          \
		LOG_INF("---- %s end  ----", p_label);                                             \
	})

#define NRF_CRYPTO_EXAMPLE_P256_KEY_SIZE (32)
#define NRF_CRYPTO_EXAMPLE_AES_256_KEY_SIZE (32)
#define NRF_CRYPTO_EXAMPLE_INPUT_KEY_SIZE (64)
#define NRF_CRYPTO_SAMPLE_SEED_VALUE_LENGTH (48)

// from NIST CTR_DRBG (no_df, no personalization string) test vector (entropy input)
//
// fc 7f 26 29 c9 d8 86 72
// f8 12 29 bb cc 0c 7e 75
// c4 b7 d8 e5 d9 38 07 02
// ea 52 dc 49 56 00 a5 6e
// 4a e5 f0 a5 c2 5f b5 d7
// e3 1f 5a ef 47 12 bc 19
static uint8_t m_seed_value[NRF_CRYPTO_SAMPLE_SEED_VALUE_LENGTH] = {
	0xfc, 0x7f, 0x26, 0x29, 0xc9, 0xd8, 0x86, 0x72,
	0xf8, 0x12, 0x29, 0xbb, 0xcc, 0x0c, 0x7e, 0x75,
	0xc4, 0xb7, 0xd8, 0xe5, 0xd9, 0x38, 0x07, 0x02,
	0xea, 0x52, 0xdc, 0x49, 0x56, 0x00, 0xa5, 0x6e,
	0x4a, 0xe5, 0xf0, 0xa5, 0xc2, 0x5f, 0xb5, 0xd7,
	0xe3, 0x1f, 0x5a, 0xef, 0x47, 0x12, 0xbc, 0x19
};

#if !defined(NRF_CRYPTO_EXAMPLE_DEMO_ECDSA)
// NOTE: the following buffer is the same as the one in "key_operations.c"
static const uint8_t m_required_plain_text[NRF_CRYPTO_EXAMPLE_KMU_USAGE_KEY_MAX_TEXT_SIZE] = {
	"Example string to demonstrate basic usage of KMU."};

static const uint8_t m_required_ciphertext[NRF_CRYPTO_EXAMPLE_KMU_USAGE_KEY_MAX_TEXT_SIZE] = {
	// for MKEK key
	0xd8, 0x14, 0x63, 0x81, 0x41, 0x4b, 0x4d, 0x46, 0x10, 0x8c, 0xd8, 0x71, 0xa9, 0x7f, 0xae, 0x82,
	0x55, 0x65, 0x4f, 0x0a, 0xb2, 0xd6, 0x8f, 0x73, 0x4c, 0xac, 0x24, 0xef, 0xd8, 0x30, 0x02, 0x8d,
	0xb8, 0x4a, 0x8b, 0xda, 0xf6, 0xf7, 0x77, 0xd4, 0xbd, 0xcc, 0x06, 0x1f, 0xc9, 0x8a, 0x7b, 0xd4,
	0x5c, 0xb0, 0x47, 0xf6, 0xab, 0x83, 0x91, 0x02, 0xe9, 0x4f, 0x93, 0x01, 0x91, 0x27, 0x52, 0x89,
	0x42, 0xad, 0x9e, 0xde, 0xd3, 0xae, 0xf8, 0xb0, 0x53, 0xa7, 0xfa, 0xe3, 0x5f, 0xc6, 0x2f, 0xaf,
	0x42, 0xad, 0x9e, 0xde, 0xd3, 0xae, 0xf8, 0xb0, 0x53, 0xa7, 0xfa, 0xe3, 0x5f, 0xc6, 0x2f, 0xaf,

	// for MEXT key
	// 0x29, 0x94, 0xb4, 0xe4, 0x4b, 0xec, 0x2d, 0x0d, 0x35, 0xe8, 0x58, 0xf5, 0x25, 0xe8, 0x18, 0x0c,
	// 0x21, 0xb3, 0xb1, 0x16, 0x8c, 0x80, 0xda, 0xaa, 0x10, 0x92, 0xcd, 0xd0, 0x72, 0xda, 0xcc, 0x0b,
	// 0xfe, 0x8b, 0x32, 0xf0, 0xf4, 0x12, 0x5b, 0x85, 0x80, 0xff, 0x47, 0xd2, 0xb0, 0xf8, 0x7e, 0x6f,
	// 0x64, 0x48, 0xff, 0x1c, 0x54, 0xe7, 0x46, 0x0e, 0x5f, 0x17, 0xc8, 0xb8, 0xf2, 0xf5, 0x72, 0x92,
	// 0x45, 0xcb, 0x7e, 0x55, 0x0a, 0xe3, 0x75, 0x1c, 0x73, 0x4a, 0x52, 0x25, 0xac, 0x3f, 0x60, 0x01,
	// 0x45, 0xcb, 0x7e, 0x55, 0x0a, 0xe3, 0x75, 0x1c, 0x73, 0x4a, 0x52, 0x25, 0xac, 0x3f, 0x60, 0x01,
};
#endif /* NRF_CRYPTO_EXAMPLE_DEMO_ECDSA */

static psa_key_id_t output_key_id;

#ifdef CONFIG_CRACEN_HW_VERSION_LITE
#define MAX_BITS_PER_REQUEST (1 << 16) /* Cracen Lite only supports 2^16 ctr size */
/* Cracen Lite only supports 2^16 ctr size so will need to reseed before it overflows */
#define RESEED_INTERVAL ((uint64_t)1 << 16)
#else
#define MAX_BITS_PER_REQUEST (1 << 19) /* NIST.SP.800-90Ar1:Table 3 */
#define RESEED_INTERVAL ((uint64_t)1 << 48) /* 2^48 as per NIST spec */
#endif

/* IAR Doesn't support aligned stack variables */
#define ALIGN_UP(value, alignment) \
  (((value) + (alignment) - 1) & ~((alignment) - 1))

#ifdef __IAR_SYSTEMS_ICC__
#define ALIGN_ON_STACK(type, var, size, alignment)                    \
  type var##base[(size) + ((alignment)/sizeof(type))]; \
  type * var = (type *)ALIGN_UP((intptr_t)var##base, alignment)
#else
#define ALIGN_ON_STACK(type, var, size, alignment)                    \
  type var[size] __attribute__((aligned(alignment)));
#endif

#define CRACEN_ENTROPY_AND_NONCE_SIZE (CRACEN_PRNG_ENTROPY_SIZE + CRACEN_PRNG_NONCE_SIZE)

static cracen_prng_context_t prng;
/* ====================================================================== */

static void reverse_bytes(uint8_t *data, size_t len)
{
	size_t i = 0;
	size_t j = len - 1;

	while (i < j) {
		uint8_t tmp = data[i];
		data[i] = data[j];
		data[j] = tmp;
		i++;
		j--;
	}
}

/**
 *  Implementation of the CTR_DRBG_Update process as described in NIST.SP.800-90Ar1
 *  with ctr_len equal to blocklen.
 * 
 *  Note: this function is mainly taken from "cracen_psa_ctr_drbg.c"
 * 
 *  data is expected to be the entropy (SEED) buffer
 */
static psa_status_t ctr_drbg_update(uint8_t *seed)
{
	psa_status_t status = PSA_SUCCESS;

	ALIGN_ON_STACK(uint8_t, temp, CRACEN_ENTROPY_AND_NONCE_SIZE, CONFIG_DCACHE_LINE_SIZE);

	size_t temp_length = 0;
	_Static_assert(CRACEN_ENTROPY_AND_NONCE_SIZE % SX_BLKCIPHER_AES_BLK_SZ == 0, "");

	while (temp_length < CRACEN_ENTROPY_AND_NONCE_SIZE) {

		cracen_be_add(prng.V, SX_BLKCIPHER_AES_BLK_SZ, 1);
		status = sx_blkcipher_ecb_simple(prng.key, sizeof(prng.key), prng.V, sizeof(prng.V),
						 temp + temp_length, SX_BLKCIPHER_AES_BLK_SZ);

		if (status != PSA_SUCCESS) {
			return status;
		}
		temp_length += SX_BLKCIPHER_AES_BLK_SZ;
		prng.reseed_counter++;
	}

	if (seed) {
		cracen_xorbytes(temp, seed, CRACEN_ENTROPY_AND_NONCE_SIZE);
	}

	memcpy(prng.key, temp, sizeof(prng.key));
	memcpy(prng.V, temp + sizeof(prng.key), sizeof(prng.V));

	// PRINT_HEX("Key", prng.key, sizeof(prng.key));
	// PRINT_HEX("V", prng.V, sizeof(prng.V));

	return status;
}

/**
 * @brief Implementation is taken from "cracen_get_random()"
 *
 * @param output 
 * @param output_size 
 * @return 
 */
static psa_status_t ctr_drbg_generate(uint8_t *output, size_t output_size)
{
	psa_status_t status = PSA_SUCCESS;
	size_t len_left = output_size;
	size_t number_of_blocks = DIV_ROUND_UP(output_size, SX_BLKCIPHER_AES_BLK_SZ);

	if (output_size > 0 && output == NULL) {
		return PSA_ERROR_INVALID_ARGUMENT;
	}

	if (output_size > PSA_BITS_TO_BYTES(MAX_BITS_PER_REQUEST)) {
		return PSA_ERROR_INVALID_ARGUMENT;
	}

	// nrf_security_mutex_lock(cracen_prng_trng_mutex);

	// if (prng.reseed_counter == 0) {
	// 	/* Zephyr mutexes allow the same thread to lock a
	// 	 * mutex multiple times. So we can call cracen_init_random
	// 	 * here even though we hold the mutex.
	// 	 */
	// 	status = cracen_init_random(context);
	// 	if (status != PSA_SUCCESS) {
	// 		// nrf_security_mutex_unlock(cracen_prng_trng_mutex);
	// 		return status;
	// 	}
	// }

	// if (prng.reseed_counter + number_of_blocks >= RESEED_INTERVAL) {
	// 	status = cracen_reseed();
	// 	if (status != PSA_SUCCESS) {
	// 		// nrf_security_mutex_unlock(cracen_prng_trng_mutex);
	// 		return status;
	// 	}
	// }

	while (len_left > 0) {
		size_t cur_len = MIN(len_left, SX_BLKCIPHER_AES_BLK_SZ);
		ALIGN_ON_STACK(uint8_t, temp, SX_BLKCIPHER_AES_BLK_SZ, CONFIG_DCACHE_LINE_SIZE);

		cracen_be_add(prng.V, SX_BLKCIPHER_AES_BLK_SZ, 1);
		status = sx_blkcipher_ecb_simple(prng.key, sizeof(prng.key), prng.V, sizeof(prng.V),
						 temp, SX_BLKCIPHER_AES_BLK_SZ);

		if (status != PSA_SUCCESS) {
			// nrf_security_mutex_unlock(cracen_prng_trng_mutex);
			return status;
		}

		for (int i = 0; i < cur_len; i++) {
			output[i] = temp[i];
		}

		len_left -= cur_len;
		output += cur_len;
		prng.reseed_counter++;
	}

	status = ctr_drbg_update(NULL);
	// nrf_security_mutex_unlock(cracen_prng_trng_mutex);
	return status;
}

#if !defined(NRF_CRYPTO_EXAMPLE_DEMO_ECDSA)
static bool check_aes_key(psa_key_id_t *key_id)
{
	bool ciphertext_match = false;
	uint32_t olen;
	psa_status_t status;

	psa_algorithm_t alg = PSA_ALG_ECB_NO_PADDING;

	uint8_t encrypted_text[PSA_CIPHER_ENCRYPT_OUTPUT_SIZE(
		PSA_KEY_TYPE_AES, alg, NRF_CRYPTO_EXAMPLE_KMU_USAGE_KEY_MAX_TEXT_SIZE)];
	uint8_t decrypted_text[NRF_CRYPTO_EXAMPLE_KMU_USAGE_KEY_MAX_TEXT_SIZE];

	status = psa_cipher_encrypt(*key_id, alg, m_required_plain_text, sizeof(m_required_plain_text),
				    encrypted_text, sizeof(encrypted_text), &olen);
	if (status != PSA_SUCCESS) {
		LOG_INF("psa_cipher_encrypt failed! (Error: %d)", status);
		return false;
	}

	PRINT_HEX("Encrypted text", encrypted_text, sizeof(encrypted_text));

	/* Check the validity of the decryption */
	ciphertext_match = memcmp(encrypted_text, m_required_ciphertext, olen) == 0;

	return ciphertext_match;
}
#endif /* NRF_CRYPTO_EXAMPLE_DEMO_ECDSA */

static const uint8_t key_with_pers_key[] =
{
    0xA4, 0x1F, 0x61, 0xB5, 0x00, 0x2B, 0x76, 0x84,
    0xB0, 0x1A, 0xE4, 0xC9, 0x97, 0xD8, 0xF4, 0x2F,
    0x6D, 0x7A, 0xB1, 0x61, 0xD9, 0xD2, 0x4E, 0xFB,
    0xE6, 0x7B, 0xC1, 0x86, 0x7E, 0x02, 0x9C, 0xC3
};

void demo_ikg_keygen()
{
	psa_status_t status;
	uint8_t gen_key[NRF_CRYPTO_EXAMPLE_AES_256_KEY_SIZE];
	bool key_found = false;
	psa_key_attributes_t key_attributes = PSA_KEY_ATTRIBUTES_INIT;

	// reverse_bytes(m_seed_value, sizeof(m_seed_value));

	// /* Instantiate */
	// status = ctr_drbg_update(m_seed_value);
	// if (status != PSA_SUCCESS) {
	// 	LOG_INF("ctr_drbg_update failed! (Error: %d)", status);
	// 	return;
	// }

#if !defined(NRF_CRYPTO_EXAMPLE_DEMO_ECDSA)

	/* Configure the input key attributes */
	psa_set_key_lifetime(&key_attributes, PSA_KEY_LIFETIME_VOLATILE);
	psa_set_key_type(&key_attributes, PSA_KEY_TYPE_AES);
	psa_set_key_algorithm(&key_attributes, PSA_ALG_ECB_NO_PADDING);
	psa_set_key_usage_flags(&key_attributes, PSA_KEY_USAGE_ENCRYPT | PSA_KEY_USAGE_DECRYPT | PSA_KEY_USAGE_EXPORT);
	psa_set_key_bits(&key_attributes, 256);

	// /* Generating keys from SEED */
	// for (uint32_t i = 0; i < 3; i++) {
	// 	status = ctr_drbg_generate(gen_key, NRF_CRYPTO_EXAMPLE_AES_256_KEY_SIZE);
	// 	if (status != PSA_SUCCESS) {
	// 		LOG_INF("ctr_drbg_generate failed! (Error: %d, counter: %d)", status, i);
	// 		return;
	// 	}

		memcpy(gen_key, key_with_pers_key, NRF_CRYPTO_EXAMPLE_AES_256_KEY_SIZE);

		PRINT_HEX("gen_key (cntr)", gen_key, NRF_CRYPTO_EXAMPLE_AES_256_KEY_SIZE);

		/* Import the master key into the keystore */
		status = psa_import_key(&key_attributes,
					gen_key,
					NRF_CRYPTO_EXAMPLE_AES_256_KEY_SIZE,
					&output_key_id);
		if (status != PSA_SUCCESS) {
			LOG_INF("psa_import_key failed! (Error: %d)", status);
			return;
		}

		safe_memzero(gen_key, NRF_CRYPTO_EXAMPLE_AES_256_KEY_SIZE);

		key_found = check_aes_key(&output_key_id);
		// if (key_found) {
		// 	break;
		// }

		psa_destroy_key(output_key_id);
	// }

	// LOG_WRN("Key is %sfound", key_found ? "" : "NOT ");
#else
	/* Configure the input key attributes */
	psa_set_key_lifetime(&key_attributes, PSA_KEY_LIFETIME_VOLATILE);
	psa_set_key_type(&key_attributes, PSA_KEY_TYPE_ECC_KEY_PAIR(PSA_ECC_FAMILY_SECP_R1));
	psa_set_key_algorithm(&key_attributes, PSA_ALG_ECDSA(PSA_ALG_SHA_256));
	psa_set_key_usage_flags(&key_attributes, PSA_KEY_USAGE_SIGN_MESSAGE | PSA_KEY_USAGE_SIGN_HASH |
						 PSA_KEY_USAGE_VERIFY_MESSAGE| PSA_KEY_USAGE_VERIFY_HASH |
						 PSA_KEY_USAGE_EXPORT);
	psa_set_key_bits(&key_attributes, 256);

	/* Generating symmetric keys from SEED */
	for (uint32_t i = 0; i < 2; i++) { /* IKG generates 2 symmetric keys */
		status = ctr_drbg_generate(gen_key, NRF_CRYPTO_EXAMPLE_AES_256_KEY_SIZE);
		if (status != PSA_SUCCESS) {
			LOG_INF("ctr_drbg_generate failed! (Error: %d, counter: %d)", status, i);
			return;
		}
	}

	/** ECC curve for IKG is P256.
	 *  CRACEN generates just a single one.
	 */
	status = ctr_drbg_generate(gen_key, NRF_CRYPTO_EXAMPLE_P256_KEY_SIZE);
	if (status != PSA_SUCCESS) {
		LOG_INF("ctr_drbg_generate failed (P256)! (Error: %d)", status);
		return;
	}

	/* Import the master key into the keystore */
	status = psa_import_key(&key_attributes,
				gen_key,
				NRF_CRYPTO_EXAMPLE_P256_KEY_SIZE,
				&output_key_id);
	if (status != PSA_SUCCESS) {
		LOG_INF("psa_import_key failed! (Error: %d)", status);
		return;
	}

	/* NOTE: Public keys must be equal for key taken from the KMU and output_key_id */
	key_operations_use_ecdsa_key_pair(&output_key_id);

#endif /* NRF_CRYPTO_EXAMPLE_DEMO_ECDSA */
}
```

## src/ikg_keygen.h
```c
/*
 * Copyright (c) 2026 Nordic Semiconductor ASA
 *
 * SPDX-License-Identifier: LicenseRef-Nordic-5-Clause
 */

#include <psa/crypto.h>
#include <psa/crypto_extra.h>

#ifndef __IKG_KEYGEN_H_
#define __IKG_KEYGEN_H_

void demo_ikg_keygen();

#endif
```

## src/key_operations.c
```c
/*
 * Copyright (c) 2025 Nordic Semiconductor ASA
 *
 * SPDX-License-Identifier: LicenseRef-Nordic-5-Clause
 */

#include "key_operations.h"
#include "main.h"

#include <zephyr/device.h>
#include <zephyr/logging/log.h>
#include <zephyr/settings/settings.h>

#include <cracen_psa_kmu.h>

LOG_MODULE_DECLARE(kmu_cracen_usage, LOG_LEVEL_DBG);

/* ====================================================================== */
/*			Global variables/defines for operations on the KMU keys		  */

#define PRINT_HEX(p_label, p_text, len)                                                            \
	({                                                                                         \
		LOG_INF("---- %s (len: %u): ----", p_label, len);                                  \
		LOG_HEXDUMP_INF(p_text, len, "Content:");                                          \
		LOG_INF("---- %s end  ----", p_label);                                             \
	})

/* Below text is used as plaintext for encryption/decryption */
static uint8_t m_plain_text[NRF_CRYPTO_EXAMPLE_KMU_USAGE_KEY_MAX_TEXT_SIZE] = {
	"Example string to demonstrate basic usage of KMU."};

/* ====================================================================== */

/* AES key operations */

int key_operations_generate_aes_key(psa_key_id_t *key_id)
{
	psa_status_t status;
	psa_key_id_t tmp_key_id;

	if (key_id == NULL) {
		LOG_ERR("Provide a valid key ID to generate the key");
		return PSA_ERROR_INVALID_ARGUMENT;
	}
	tmp_key_id = *key_id;

	LOG_INF("Generating random AES key...");

	/* Configure the key attributes */
	psa_key_attributes_t key_attributes = PSA_KEY_ATTRIBUTES_INIT;

	psa_set_key_usage_flags(&key_attributes, PSA_KEY_USAGE_ENCRYPT | PSA_KEY_USAGE_DECRYPT);
	psa_set_key_algorithm(&key_attributes, PSA_ALG_CTR);
	psa_set_key_type(&key_attributes, PSA_KEY_TYPE_AES);
	psa_set_key_bits(&key_attributes, 128);

	/* Persistent key specific settings */
	psa_set_key_lifetime(&key_attributes,
			     PSA_KEY_LIFETIME_FROM_PERSISTENCE_AND_LOCATION(
				     PSA_KEY_PERSISTENCE_DEFAULT, PSA_KEY_LOCATION_CRACEN_KMU));
	psa_set_key_id(&key_attributes, *key_id);

	/* Generate a random AES key with persistent lifetime. The key can be used for
	 * encryption/decryption using the key_id.
	 * The key itself will be stored to the KMU peripheral.
	 */
	status = psa_generate_key(&key_attributes, key_id);

	if (status == PSA_ERROR_ALREADY_EXISTS) {
		/* Revering the key ID to the one provided.
		 * Reason: psa_generate_key() modifies it
		 */
		*key_id = tmp_key_id;
		psa_reset_key_attributes(&key_attributes);
		return status;
	} else if (status != PSA_SUCCESS) {
		LOG_INF("psa_generate_key failed! (Error: %d)", status);
		return status;
	}

	/* Make sure the key metadata is not in memory anymore,
	 * has the same affect as resetting the device
	 */
	status = psa_purge_key(*key_id);
	if (status != PSA_SUCCESS) {
		LOG_INF("psa_purge_key failed! (Error: %d)", status);
		return status;
	}

	/* After the key handle is acquired the attributes are not needed */
	psa_reset_key_attributes(&key_attributes);

	LOG_INF("A key generated successfully!");

	return status;
}

int key_operations_use_aes_key(psa_key_id_t *key_id)
{
	uint32_t olen;
	psa_status_t status;

	if (key_id == NULL) {
		LOG_ERR("Provide a valid key ID to generate the key");
		return PSA_ERROR_INVALID_ARGUMENT;
	}

	psa_algorithm_t alg = /*PSA_ALG_CTR*/ PSA_ALG_ECB_NO_PADDING;

	uint8_t encrypted_text[PSA_CIPHER_ENCRYPT_OUTPUT_SIZE(
		PSA_KEY_TYPE_AES, alg, NRF_CRYPTO_EXAMPLE_KMU_USAGE_KEY_MAX_TEXT_SIZE)];
	uint8_t decrypted_text[NRF_CRYPTO_EXAMPLE_KMU_USAGE_KEY_MAX_TEXT_SIZE];

	status = psa_cipher_encrypt(*key_id, alg, m_plain_text, sizeof(m_plain_text),
				    encrypted_text, sizeof(encrypted_text), &olen);
	if (status != PSA_SUCCESS) {
		LOG_INF("psa_cipher_encrypt failed! (Error: %d)", status);
		return status;
	}

	LOG_INF("Encryption successful!");
	PRINT_HEX("Plaintext", m_plain_text, sizeof(m_plain_text));
	PRINT_HEX("Encrypted text", encrypted_text, sizeof(encrypted_text));

	status = psa_cipher_decrypt(*key_id, alg, encrypted_text, sizeof(encrypted_text),
				    decrypted_text, sizeof(decrypted_text), &olen);
	if (status != PSA_SUCCESS) {
		LOG_INF("psa_cipher_decrypt failed! (Error: %d)", status);
		return status;
	}

	PRINT_HEX("Decrypted text", decrypted_text, sizeof(decrypted_text));

	/* Check the validity of the decryption */
	if (memcmp(decrypted_text, m_plain_text, NRF_CRYPTO_EXAMPLE_KMU_USAGE_KEY_MAX_TEXT_SIZE) !=
	    0) {
		LOG_INF("Error: Decrypted text doesn't match the plaintext");
		return status;
	}

	LOG_INF("Decryption successful!");

	return status;
}

/* ECC key pair operations */

/* EdDSA */

static int key_operations_import_eddsa_pub_key(const uint8_t *p_key, size_t key_size,
					       psa_key_id_t *key_id)
{
	assert(p_key != NULL);
	assert(key_id != NULL);

	/* Configure the key attributes */
	psa_key_attributes_t key_attributes = PSA_KEY_ATTRIBUTES_INIT;
	psa_status_t status;

	/* Configure the key attributes */
	psa_set_key_usage_flags(&key_attributes, PSA_KEY_USAGE_VERIFY_MESSAGE);
	psa_set_key_lifetime(&key_attributes, PSA_KEY_LIFETIME_VOLATILE);
	psa_set_key_algorithm(&key_attributes, PSA_ALG_PURE_EDDSA);
	psa_set_key_type(&key_attributes,
			 PSA_KEY_TYPE_ECC_PUBLIC_KEY(PSA_ECC_FAMILY_TWISTED_EDWARDS));
	psa_set_key_bits(&key_attributes, 255);

	status = psa_import_key(&key_attributes, p_key, key_size, key_id);
	if (status != PSA_SUCCESS) {
		LOG_INF("psa_import_key failed! (Error: %d)", status);
		return status;
	}

	/* Reset key attributes and free any allocated resources. */
	psa_reset_key_attributes(&key_attributes);

	return status;
}

int key_operations_use_eddsa_key_pair(psa_key_id_t *key_pair_id)
{
	psa_status_t status;
	psa_key_id_t pub_key_id;

	uint8_t pub_key[KEY_OPERATIONS_EDDSA_PUBLIC_KEY_SIZE];
	size_t pub_key_len;
	uint8_t signature[KEY_OPERATIONS_EDDSA_SIGNATURE_SIZE];
	size_t signature_len;

	if (key_pair_id == NULL) {
		LOG_ERR("Provide a valid key ID to generate the key");
		return PSA_ERROR_INVALID_ARGUMENT;
	}

	LOG_INF("Using EdDSA key pair...");

	/* Export the public key */
	status = psa_export_public_key(*key_pair_id, pub_key, sizeof(pub_key), &pub_key_len);
	if (status != PSA_SUCCESS) {
		LOG_INF("psa_export_public_key failed! (Error: %d)", status);
		return status;
	}

	PRINT_HEX("Public-key", pub_key, pub_key_len);

	status = key_operations_import_eddsa_pub_key(pub_key, pub_key_len, &pub_key_id);
	memset(pub_key, 0, sizeof(pub_key));
	if (status != PSA_SUCCESS) {
		LOG_INF("key_operations_import_eddsa_pub_key failed! (Error: %d)", status);
		return status;
	}

	LOG_INF("Signing a message using EDDSA...");

	/* Sign the message */
	status = psa_sign_message(*key_pair_id, PSA_ALG_PURE_EDDSA, m_plain_text,
				  sizeof(m_plain_text), signature, sizeof(signature),
				  &signature_len);
	if (status != PSA_SUCCESS) {
		LOG_INF("psa_sign_message failed! (Error: %d)", status);
		goto exit;
	}

	LOG_INF("Message signed successfully!");
	PRINT_HEX("Plaintext", m_plain_text, sizeof(m_plain_text));
	PRINT_HEX("Signature", signature, sizeof(signature));

	LOG_INF("Verifying EDDSA signature...");

	/* Verify the signature of the message */
	status = psa_verify_message(pub_key_id, PSA_ALG_PURE_EDDSA, m_plain_text,
				    sizeof(m_plain_text), signature, signature_len);
	if (status != PSA_SUCCESS) {
		LOG_INF("psa_verify_message failed! (Error: %d)", status);
		goto exit;
	}

	LOG_INF("EdDSA signature verification was successful!");

exit:
	psa_destroy_key(pub_key_id);
	return status;
}

/* ECDSA */

static int key_operations_import_ecdsa_pub_key(const uint8_t *p_key, size_t key_size,
					       psa_key_id_t *key_id)
{
	assert(p_key != NULL);
	assert(key_id != NULL);

	/* Configure the key attributes */
	psa_key_attributes_t key_attributes = PSA_KEY_ATTRIBUTES_INIT;
	psa_status_t status;

	/* Configure the key attributes */
	psa_set_key_usage_flags(&key_attributes, PSA_KEY_USAGE_VERIFY_HASH);
	psa_set_key_lifetime(&key_attributes, PSA_KEY_LIFETIME_VOLATILE);
	psa_set_key_algorithm(&key_attributes, PSA_ALG_ECDSA(PSA_ALG_SHA_256));
	psa_set_key_type(&key_attributes, PSA_KEY_TYPE_ECC_PUBLIC_KEY(PSA_ECC_FAMILY_SECP_R1));
	psa_set_key_bits(&key_attributes, 256);

	status = psa_import_key(&key_attributes, p_key, key_size, key_id);
	if (status != PSA_SUCCESS) {
		LOG_INF("psa_import_key failed! (Error: %d)", status);
		return status;
	}

	/* Reset key attributes and free any allocated resources. */
	psa_reset_key_attributes(&key_attributes);

	return status;
}

int key_operations_generate_ecdsa_key_pair(psa_key_id_t *key_pair_id)
{
	psa_status_t status;
	psa_key_id_t tmp_key_id;

	if (key_pair_id == NULL) {
		LOG_ERR("Provide a valid key ID to generate the key");
		return PSA_ERROR_INVALID_ARGUMENT;
	}
	tmp_key_id = *key_pair_id;

	LOG_INF("Generating random ECDSA keypair...");

	/* Configure the key attributes */
	psa_key_attributes_t key_attributes = PSA_KEY_ATTRIBUTES_INIT;

	psa_set_key_usage_flags(&key_attributes, PSA_KEY_USAGE_SIGN_HASH);
	psa_set_key_algorithm(&key_attributes, PSA_ALG_ECDSA(PSA_ALG_SHA_256));
	psa_set_key_type(&key_attributes, PSA_KEY_TYPE_ECC_KEY_PAIR(PSA_ECC_FAMILY_SECP_R1));
	psa_set_key_bits(&key_attributes, 256);

	/* Persistent key specific settings */
	psa_set_key_lifetime(&key_attributes,
			     PSA_KEY_LIFETIME_FROM_PERSISTENCE_AND_LOCATION(
				     PSA_KEY_PERSISTENCE_DEFAULT, PSA_KEY_LOCATION_CRACEN_KMU));
	psa_set_key_id(&key_attributes, *key_pair_id);

	/* Generate a random keypair. The keypair is not exposed to the application,
	 * we can use it to sign hashes.
	 */
	status = psa_generate_key(&key_attributes, key_pair_id);

	if (status == PSA_ERROR_ALREADY_EXISTS) {
		/* Using key_pair_id without any modifications. */
		*key_pair_id = tmp_key_id;
		psa_reset_key_attributes(&key_attributes);
		return status;
	} else if (status != PSA_SUCCESS) {
		LOG_INF("psa_generate_key failed! (Error: %d)", status);
		return status;
	}

	/* Make sure the key metadata is not in memory anymore,
	 * has the same affect as resetting the device
	 */
	status = psa_purge_key(*key_pair_id);
	if (status != PSA_SUCCESS) {
		LOG_INF("psa_purge_key failed! (Error: %d)", status);
		return status;
	}

	/* After the key handle is acquired the attributes are not needed */
	psa_reset_key_attributes(&key_attributes);

	LOG_INF("ECDSA key pair generated successfully!");

	return status;
}

int key_operations_use_ecdsa_key_pair(psa_key_id_t *key_pair_id)
{
	psa_status_t status;
	psa_key_id_t pub_key_id;
	uint32_t output_len;

	uint8_t pub_key[KEY_OPERATIONS_ECDSA_PUBLIC_KEY_SIZE];
	size_t pub_key_len;
	uint8_t signature[KEY_OPERATIONS_ECDSA_SIGNATURE_SIZE];
	uint8_t hash[KEY_OPERATIONS_ECDSA_HASH_SIZE];

	if (key_pair_id == NULL) {
		LOG_ERR("Provide a valid key ID to generate the key");
		return PSA_ERROR_INVALID_ARGUMENT;
	}

	LOG_INF("Using ECDSA key pair...");

	/* Export the public key */
	status = psa_export_public_key(*key_pair_id, pub_key, sizeof(pub_key), &pub_key_len);
	if (status != PSA_SUCCESS) {
		LOG_INF("psa_export_public_key failed! (Error: %d)", status);
		return status;
	}

	PRINT_HEX("Public-key", pub_key, pub_key_len);

	status = key_operations_import_ecdsa_pub_key(pub_key, pub_key_len, &pub_key_id);
	memset(pub_key, 0, sizeof(pub_key));
	if (status != PSA_SUCCESS) {
		LOG_INF("key_operations_import_ecdsa_pub_key failed! (Error: %d)", status);
		return status;
	}

	LOG_INF("Signing a message using ECDSA...");

	/* Compute the SHA256 hash*/
	status = psa_hash_compute(PSA_ALG_SHA_256, m_plain_text, sizeof(m_plain_text), hash,
				  sizeof(hash), &output_len);
	if (status != PSA_SUCCESS) {
		LOG_INF("psa_hash_compute failed! (Error: %d)", status);
		goto exit;
	}

	/* Sign the hash */
	status = psa_sign_hash(*key_pair_id, PSA_ALG_ECDSA(PSA_ALG_SHA_256), hash, sizeof(hash),
			       signature, sizeof(signature), &output_len);
	if (status != PSA_SUCCESS) {
		LOG_INF("psa_sign_hash failed! (Error: %d)", status);
		goto exit;
	}

	LOG_INF("Message signed successfully!");
	PRINT_HEX("Plaintext", m_plain_text, sizeof(m_plain_text));
	PRINT_HEX("SHA256 hash", hash, sizeof(hash));
	PRINT_HEX("Signature", signature, sizeof(signature));

	LOG_INF("Verifying ECDSA signature...");

	/* Verify the signature of the hash */
	status = psa_verify_hash(pub_key_id, PSA_ALG_ECDSA(PSA_ALG_SHA_256), hash, sizeof(hash),
				 signature, sizeof(signature));
	if (status != PSA_SUCCESS) {
		LOG_INF("psa_verify_hash failed! (Error: %d)", status);
		goto exit;
	}

	LOG_INF("ECDSA signature verification was successful!");

exit:
	psa_destroy_key(pub_key_id);
	return status;
}
```

## src/main.h
```c
/*
 * Copyright (c) 2025 Nordic Semiconductor ASA
 *
 * SPDX-License-Identifier: LicenseRef-Nordic-5-Clause
 */

#include <psa/crypto.h>
#include <psa/crypto_extra.h>

#ifndef __MAIN_H_
#define __MAIN_H_

// #define NRF_CRYPTO_EXAMPLE_DEMO_ECDSA

#define NRF_CRYPTO_EXAMPLE_KMU_USAGE_KEY_MAX_TEXT_SIZE (96)

/**
 * @brief Callback function called to generate specific key.
 *
 * @param key_id A pointer to the key ID.
 *
 * @return psa_status_t
 */
typedef int (*generate_key_callback_t)(psa_key_id_t *key_id);

/**
 * @brief Callback function called to execute key usage functionality.
 *
 * @param key_id A pointer to the key ID.
 *
 * @return psa_status_t
 */
typedef int (*use_key_callback_t)(psa_key_id_t *key_id);

typedef struct {
	const generate_key_callback_t gen_key_cb;
	const use_key_callback_t use_key_cb;
} sample_key_operations_t;

typedef struct {
	psa_key_id_t key_id;
	sample_key_operations_t supported_operations;
} sample_key_entry_t;

#endif
```
