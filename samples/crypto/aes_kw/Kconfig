## samples/crypto/aes_kw/Kconfig
```kconfig
#
# Copyright (c) 2026 Nordic Semiconductor
#
# SPDX-License-Identifier: LicenseRef-Nordic-5-Clause
#

source "Kconfig.zephyr"

menu "AES KW sample"

config AES_KW_SAMPLE_SHOW_KWP
        bool "Demonstrate AES-KWP usage instead of AES-KW"
        default n
        help
          When activated, sample demonstrates AES-KWP (key wrap with padding)
          algorithm usage.

endmenu
```

## samples/crypto/kmu_usage_nrf54l/sample.yaml
```yaml
sample:
  description: |
    This sample provides an example of using key provisioning and the KMU
    (Key Management Unit) with the PSA Crypto API.
    Different types of keys are generated and stored to the KMU.
  name: KMU usage for nRF54L

common:
  sysbuild: true
  tags:
    - introduction
    - kmu
    - sysbuild
    - ci_samples_crypto
  harness: console
  harness_config:
    type: multi_line
    regex:
      - ".*Example finished successfully!.*"

tests:
  sample.kmu_usage_nrf54l.tf-m:
    tags:
      - ci_samples_tfm
    platform_allow:
      - nrf54l15dk/nrf54l15/cpuapp/ns
      - nrf54l15dk/nrf54l10/cpuapp/ns
      - nrf54lv10dk/nrf54lv10a/cpuapp/ns
    integration_platforms: 
      - nrf54l15dk/nrf54l15/cpuapp/ns
      - nrf54lv10dk/nrf54lv10a/cpuapp/ns

  sample.kmu_usage_nrf54l.secure_storage:
    platform_allow:
      - nrf54l15dk/nrf54l15/cpuapp
      - nrf54lm20dk/nrf54lm20a/cpuapp
      - nrf54lv10dk/nrf54lv10a/cpuapp
      - nrf54l15dk/nrf54l10/cpuapp
      - nrf54l15dk/nrf54l05/cpuapp
    integration_platforms:
      - nrf54l15dk/nrf54l15/cpuapp
      - nrf54lm20dk/nrf54lm20a/cpuapp
      - nrf54lv10dk/nrf54lv10a/cpuapp
  sample.kmu_usage_nrf54l.trusted_storage:
    extra_args:
      - CONFIG_SECURE_STORAGE=n
      - CONFIG_TRUSTED_STORAGE=y
    platform_allow:
      - nrf54l15dk/nrf54l15/cpuapp
      - nrf54lm20dk/nrf54lm20a/cpuapp
      - nrf54lv10dk/nrf54lv10a/cpuapp
      - nrf54lm20dk/nrf54lm20a/cpuapp
      - nrf54l15dk/nrf54l10/cpuapp
      - nrf54l15dk/nrf54l05/cpuapp
      - nrf54lv10dk/nrf54lv10a/cpuapp
    integration_platforms:
      - nrf54l15dk/nrf54l15/cpuapp
      - nrf54lm20dk/nrf54lm20a/cpuapp
      - nrf54lv10dk/nrf54lv10a/cpuapp
```

## tests/subsys/nrf_security/ecies_sec1/testcase.yaml
```yaml
tests:
  ecies_sec1.cracen:
    sysbuild: true
    tags:
      - psa
      - sysbuild
      - ci_crypto
      - ci_tests_crypto
    platform_allow:
      - nrf54l15dk/nrf54l15/cpuapp
    integration_platforms:
      - nrf54l15dk/nrf54l15/cpuapp
#    extra_args:
#      - EXTRA_CONF_FILE=overlays/cracen.conf
```
